## ntsync/6.10/Kconfig
```kconfig
# SPDX-License-Identifier: GPL-2.0
menu "Device Drivers"

source "drivers/media/Kconfig"

endmenu
```

## ntsync/6.10/drivers/misc/Kconfig
```kconfig
# SPDX-License-Identifier: GPL-2.0-only
#
# Misc strange devices
#

menu "Misc devices"

config NTSYNC
	tristate "NT synchronization primitive emulation"
	depends on BROKEN
	help
	  This module provides kernel support for emulation of Windows NT
	  synchronization primitives. It is not a hardware driver.

	  To compile this driver as a module, choose M here: the
	  module will be called ntsync.

	  If unsure, say N.

endmenu
```
